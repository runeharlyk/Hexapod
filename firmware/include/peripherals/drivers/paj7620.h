#pragma once

#include <cstdint>
#include <optional>
#include <peripherals/i2c_bus.h>

/*
 * PAJ7620U2 gesture sensor over the shared I2C bus, ported from SpotMicroESP32-Leika's
 * esp32/include/peripherals/gesture.h: the vendor's register initialisation and the gesture flags, which the chip
 * clears as they are read. A read never waits, so the sensor can be polled from a task that shares the bus with the
 * control task; the vendor's entry and quit delays are gesture::Filter's (gesture.h).
 */
class PAJ7620Driver {
  public:
    static constexpr uint8_t ADDR = 0x73;

    // Answers with its part ID and takes the whole initialisation. The vendor's sample selects bank 0 twice before
    // reading the ID: the first transfer after power-up wakes the chip and may go unanswered.
    bool begin() {
        selectBank(0);
        selectBank(0);
        uint8_t id[2] = {0, 0};
        if (I2CBus::instance().readReg(ADDR, REG_PART_ID, id, 2) != ESP_OK) return false;
        if ((id[0] | id[1] << 8) != PART_ID) return false;
        for (const auto &[reg, value] : INIT)
            if (I2CBus::instance().writeReg(ADDR, reg, &value, 1) != ESP_OK) return false;
        return selectBank(0);
    }

    // The gesture flags set since the last read, register 0x44 (the wave) over 0x43; none when a read failed.
    std::optional<uint16_t> readFlags() {
        uint8_t low = 0, high = 0;
        if (I2CBus::instance().readReg(ADDR, REG_FLAG_HIGH, &high, 1) != ESP_OK) return std::nullopt;
        if (I2CBus::instance().readReg(ADDR, REG_FLAG_LOW, &low, 1) != ESP_OK) return std::nullopt;
        return static_cast<uint16_t>(high << 8 | low);
    }

  private:
    static constexpr uint8_t REG_BANK_SEL = 0xEF;
    static constexpr uint8_t REG_PART_ID = 0x00;
    static constexpr uint8_t REG_FLAG_LOW = 0x43;
    static constexpr uint8_t REG_FLAG_HIGH = 0x44;
    static constexpr uint16_t PART_ID = 0x7620;

    bool selectBank(uint8_t bank) { return I2CBus::instance().writeReg(ADDR, REG_BANK_SEL, &bank, 1) == ESP_OK; }

    // The vendor's gesture-mode initialisation, as Leika has it: register and value, bank selects included.
    static constexpr uint8_t INIT[219][2] = {
        {0xEF, 0x00}, {0x32, 0x29}, {0x33, 0x01}, {0x34, 0x00}, {0x35, 0x01}, {0x36, 0x00}, {0x37, 0x07}, {0x38, 0x17},
        {0x39, 0x06}, {0x3A, 0x12}, {0x3F, 0x00}, {0x40, 0x02}, {0x41, 0xFF}, {0x42, 0x01}, {0x46, 0x2D}, {0x47, 0x0F},
        {0x48, 0x3C}, {0x49, 0x00}, {0x4A, 0x1E}, {0x4B, 0x00}, {0x4C, 0x20}, {0x4D, 0x00}, {0x4E, 0x1A}, {0x4F, 0x14},
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        {0x7C, 0x84}, {0x7D, 0x03}, {0x7E, 0x01}};
};
